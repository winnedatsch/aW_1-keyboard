## firmware/custom/zephyr/boards/arm/aW_1/Kconfig.defconfig
```kconfig
if BOARD_AW_1

config BOARD
	default "aW_1"

config BT_CTLR
	default BT

endif # BOARD_AW_1
```

## firmware/zephyr/boards/arm/aW_1/aW_1_defconfig
```kconfig
# SPDX-License-Identifier: Apache-2.0

CONFIG_SOC_SERIES_NRF52X=y
CONFIG_SOC_NRF52832_QFAA=y
CONFIG_BOARD_AW_1=y

# Enable MPU
CONFIG_ARM_MPU=y

# enable GPIO
CONFIG_GPIO=y

# additional board options
CONFIG_GPIO_AS_PINRESET=y
```

## firmware/zmk/aW_1/Kconfig.board
```kconfig
# aW_1 board configuration

# Copyright (c) 2020 The ZMK Contributors
# SPDX-License-Identifier: MIT

config BOARD_AW_1
	bool "aW_1"
	depends on SOC_NRF52832_QFAA
```

## firmware/zmk/aW_1/Kconfig.defconfig
```kconfig
# aW_1 board configuration

if BOARD_AW_1

config BOARD
	default "aW_1"

config BT_CTLR
	default BT

config ZMK_KEYBOARD_NAME
    default "aW_1"

config ZMK_KSCAN_MATRIX_POLLING
    default y

endif # BOARD_AW_1
```

## firmware/zmk/aW_1/aW_1_defconfig
```kconfig
CONFIG_BOARD_AW_1=y
CONFIG_SOC_SERIES_NRF52X=y
CONFIG_SOC_NRF52832_QFAA=y

# enable GPIO
CONFIG_GPIO=y

# Enable i2c
CONFIG_I2C=y

# Enable MPU
CONFIG_ARM_MPU=y

CONFIG_ZMK_BLE=y
```
